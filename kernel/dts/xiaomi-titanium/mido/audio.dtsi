&int_codec {
	status = "ok";
	/* already defined in msm8953-audio.dtsi */
	qcom,msm-hs-micbias-type = "internal";
	qcom,msm-spk-ext-pa = <&tlmm 96 0>;
	qcom,audio-routing =
		"RX_BIAS", "MCLK",
		"SPK_RX_BIAS", "MCLK",
		"INT_LDO_H", "MCLK",
		"MIC BIAS External", "Handset Mic",
		"MIC BIAS Internal2", "Headset Mic",
		"MIC BIAS External", "Secondary Mic",
		"AMIC1", "MIC BIAS External",
		"AMIC2", "MIC BIAS Internal2",
		"AMIC3", "MIC BIAS External";
	/delete-property/msm-vdd-wsa-switch-supply;
	/delete-property/qcom,msm-vdd-wsa-switch-voltage;
	/delete-property/qcom,msm-vdd-wsa-switch-current;
};
