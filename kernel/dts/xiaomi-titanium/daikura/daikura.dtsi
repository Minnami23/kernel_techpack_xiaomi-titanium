#include "../common/sdhc.dtsi"
#include "../common/spi.dtsi"
#include "display.dtsi"
#include "touchscreen.dtsi"
#include "misc.dtsi"
#include "camera.dtsi"
#include "audio.dtsi"
#include "pinctrl.dtsi"
#include "fingerprint.dtsi"
#include "pmic.dtsi"
#include "battery.dtsi"