#include "android.dtsi"
#include "soc.dtsi"
#include "cpu.dtsi"
#include "pinctrl.dtsi"
#include "audio.dtsi"
#include "haptic.dtsi"
#include "display.dtsi"
#include "regulator.dtsi"
#include "leds.dtsi"