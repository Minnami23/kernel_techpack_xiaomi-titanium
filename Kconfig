## Kconfig
```kconfig
source "techpack/xiaomi-titanium/pmic/Kconfig"
source "techpack/xiaomi-titanium/power_supply/Kconfig"
source "techpack/xiaomi-titanium/touchscreen/Kconfig"
source "techpack/xiaomi-titanium/ir/Kconfig"
source "techpack/xiaomi-titanium/leds/Kconfig"
source "techpack/xiaomi-titanium/fingerprint/Kconfig"
source "techpack/xiaomi-titanium/vibrator/Kconfig"
```

## fingerprint/Kconfig
```kconfig
source "techpack/xiaomi-titanium/fingerprint/fpc/Kconfig"
source "techpack/xiaomi-titanium/fingerprint/fpc_ysl/Kconfig"
source "techpack/xiaomi-titanium/fingerprint/fpc_mido/Kconfig"
source "techpack/xiaomi-titanium/fingerprint/goodix/Kconfig"
source "techpack/xiaomi-titanium/fingerprint/goodix_ysl/Kconfig"
source "techpack/xiaomi-titanium/fingerprint/goodix_mido/Kconfig"
```

## fingerprint/fpc_mido/Kconfig
```kconfig
config FINGERPRINT_FPC1020_MIDO
	tristate "FingerPrint Cards fingerprint driver support"
	help
	  Say Y here to enable fpc fingerprint driver support!
```

## ir/Kconfig
```kconfig
config SPI_PEELIR
	tristate "PEELIR"

	---help---
	   Enable this option if you use peelir.
```

## leds/Kconfig
```kconfig
config LEDS_AW2013_MI8953
	tristate "LED support for AW2013"
	depends on LEDS_CLASS && I2C
	help
	  This option enables support for the AW2013 RGB LED connected
	  through I2C. Say Y to enable support for the AW2013 LED.

config LEDS_AW2023_MI8953
	tristate "LED support for AW2023"
	depends on LEDS_CLASS && I2C
	help
	  This option enables support for the AW2023 RGB LED connected
	  through I2C. Say Y to enable support for the AW2013 LED.
```

## pmic/Kconfig
```kconfig
config GPIO_QPNP_PIN
	tristate "Qualcomm Technologies, Inc. QPNP GPIO support"
	depends on SPMI
	help
	  Say 'y' here to include support for the Qualcomm Technologies, Inc.
	  QPNP GPIO driver.  This driver supports Device Tree and allows a
	  device_node to be registered as a gpio-controller.  It does not handle
	  GPIO interrupts directly; they are handled via the SPMI arbiter
	  interrupt driver.

config GPIO_QPNP_PIN_DEBUG
	bool "Qualcomm Technologies, Inc. QPNP GPIO debug support"
	depends on GPIO_QPNP_PIN && DEBUG_FS
	help
	  Say 'y' here to include debug support for the Qualcomm Technologies,
	  Inc. QPNP GPIO driver.  This provides a userspace debug interface to
	  get and set all of the supported features of PMIC GPIO and MPP pins
	  including those which are managed by the gpio framework.

config LEDS_QPNP
	tristate "Support for QPNP LEDs"
	depends on LEDS_CLASS && SPMI
	help
	  This driver supports the LED functionality of Qualcomm Technologies,
	  Inc. QPNP PMICs.  It primarily supports controlling tri-color RGB
	  LEDs in both PWM and light pattern generator (LPG) modes.  For older
	  PMICs, it also supports WLEDs and flash LEDs.

config LEDS_QPNP_WLED
	tristate "Support for QPNP WLED"
	depends on LEDS_CLASS && MFD_SPMI_PMIC
	help
	  This driver supports the WLED (White LED) functionality of Qualcomm
	  Technologies, Inc. QPNP PMICs.  WLED is used for LCD backlight with
	  variable brightness.  It also supports outputting the Avdd supply for
	  AMOLED displays.

config QPNP_COINCELL
	tristate "QPNP coincell charger support"
	depends on SPMI
	help
	  This driver supports the QPNP coincell peripheral found inside of
	  Qualcomm Technologies, Inc. QPNP PMIC devices.  The coincell charger
	  provides a means to charge a coincell battery or backup capacitor
	  which is used to maintain PMIC register state when the main battery is
	  removed from the mobile device.

config PWM_QPNP
	tristate "Qualcomm Technologies, Inc. QPNP LPG/PWM support"
	depends on SPMI
	help
	  This driver supports PWM/LPG devices in Qualcomm Technologies, Inc.
	  PMIC chips which comply with QPNP.  QPNP is an SPMI based PMIC
	  implementation.  These devices support Pulse Width Modulation output
	  with user generated patterns. They share a lookup table with size of
	  64 entries.

config RTC_DRV_QPNP
	tristate "Qualcomm Technologies, Inc. QPNP PMIC RTC"
	depends on SPMI
	help
	  This enables support for the RTC found on Qualcomm Technologies, Inc.
	  QPNP PMIC chips.  This driver supports using the PMIC RTC peripheral
	  to wake a mobile device up from suspend or to wake it up from power-
	  off.
```

## touchscreen/Kconfig
```kconfig
config TOUCHSCREEN_SYSCTL_MI8953
 	bool "Sysctl control interface for Xiaomi MSM8953 touchscreens"
 	help
 	  Say Y here to enable sysctl control interface for Xiaomi MSM8953 touchscreens

source "techpack/xiaomi-titanium/touchscreen/focaltech_touch/Kconfig"
source "techpack/xiaomi-titanium/touchscreen/td4310_e7/Kconfig"
source "techpack/xiaomi-titanium/touchscreen/td4310_lansi_e7/Kconfig"

config TOUCHSCREEN_NT36672
	bool "Novatek NT36672"
	default y
	help
	  Say Y here if you have a Novatek NT36672 touchscreen connected
	  to your system.

	  If unsure, say N.

config VITURALSAR
	bool "Vitural Sar series"
	depends on I2C
	help
	  Say Y here if you have a Goodix GT9xx touchscreen.
	  Gt9xx controllers are multi touch controllers which can
	  report 5 touches at a time.

	  If unsure, say N.

config TOUCHSCREEN_TD4310_E7
	tristate "synaptics touchscreens"
	depends on I2C
	help
	  Say Y here if you have a ist3038c touchscreen.
	  Ft5x06 controllers are multi touch controllers which can
	  report 5 touches at a time.

	  If unsure, say N.

	  To compile this driver as a module, choose M here: the
	  module will be called ist3038c_ts.

config TOUCHSCREEN_TD4310_LANSI_E7
	tristate "synaptics touchscreens"
	depends on I2C
	help
	  Say Y here if you have a ist3038c touchscreen.
	  Ft5x06 controllers are multi touch controllers which can
	  report 5 touches at a time.

	  If unsure, say N.

	  To compile this driver as a module, choose M here: the
	  module will be called ist3038c_ts.
```
